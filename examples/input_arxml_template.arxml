AUTOSAR XML (schema 4-2-2)
package /ECU_Template
  ecu instance TemplateECU: ecu-description={short-label=Template ECU for AUTOSAR Configuration, category=Template}
package /ECU_Template/CanConfiguration  # CAN controller and communication configuration
package /ECU_Template/NvMConfiguration  # Non-volatile memory block configuration
package /ECU_Template/OsConfiguration  # Operating system tasks and resources
