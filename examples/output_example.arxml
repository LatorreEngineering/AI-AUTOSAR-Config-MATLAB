AUTOSAR XML (schema 4-2-2)
package /CanConfiguration
  can controller CanController_powertrain: can-controller-baudrate-config={baudrate=500000, prop-seg=6, phase-seg1=7, phase-seg2=2, sync-jump-width=1}, can-error-handling={bus-off-recovery=AUTOMATIC, error-passive-mode=ENABLED, error-warning-threshold=96}
    8 x can hw object, all with id-type=STANDARD:
      CanHwObject_0: object-type=TRANSMIT, can-object-id=256
      CanHwObject_1: object-type=RECEIVE, can-object-id=257
      CanHwObject_2: object-type=TRANSMIT, can-object-id=258
      CanHwObject_3: object-type=RECEIVE, can-object-id=259
      CanHwObject_4: object-type=TRANSMIT, can-object-id=260
      CanHwObject_5: object-type=RECEIVE, can-object-id=261
      CanHwObject_6: object-type=TRANSMIT, can-object-id=262
      CanHwObject_7: object-type=RECEIVE, can-object-id=263
